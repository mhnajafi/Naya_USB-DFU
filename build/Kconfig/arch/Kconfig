## build/Kconfig/arch/Kconfig
```kconfig
# Load arch Kconfig descriptions.
osource "/home/mhn/zephyrproject/zephyr/arch/x86/Kconfig"
osource "/home/mhn/zephyrproject/zephyr/arch/xtensa/Kconfig"
osource "/home/mhn/zephyrproject/zephyr/arch/sparc/Kconfig"
osource "/home/mhn/zephyrproject/zephyr/arch/riscv/Kconfig"
osource "/home/mhn/zephyrproject/zephyr/arch/posix/Kconfig"
osource "/home/mhn/zephyrproject/zephyr/arch/nios2/Kconfig"
osource "/home/mhn/zephyrproject/zephyr/arch/mips/Kconfig"
osource "/home/mhn/zephyrproject/zephyr/arch/arm64/Kconfig"
osource "/home/mhn/zephyrproject/zephyr/arch/arm/Kconfig"
osource "/home/mhn/zephyrproject/zephyr/arch/arc/Kconfig"
```
